// SPDX-License-Identifier: BSD-3-Clause
/*
 * Copyright (c) 2020, Konrad Dybcio
 */

/dts-v1/;

#include "msm8992.dtsi"


/ {
	model = "Xiaomi Mi 4C";
	compatible = "xiaomi,libra", "qcom,msm8992";
	/* required for bootloader to select correct board */
	qcom,msm-id = <251 0 252 0>;
    qcom,pmic-id = <65545 65546 0 0>;
	qcom,board-id = <12 0>;

	/* This enables graphical output via bootloader-enabled display */
	chosen {
		bootargs = "earlycon=tty0 console=tty0";

		#address-cells = <2>;
		#size-cells = <2>;
		ranges;

		framebuffer0: framebuffer@3404000 {
			status= "okay";
			compatible = "simple-framebuffer";
			reg = <0 0x3404000 0 (1080 * 1920 * 3)>;
			width = <1080>;
			height = <1920>;
			stride = <(1080 * 3)>;
			format = "r8g8b8";
		};
	};
